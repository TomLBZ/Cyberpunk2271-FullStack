#include "Music.h"
#include "ConstantDefinitions.h"

volatile uint8_t MUSIC_CHOICE = 1;
volatile uint16_t currentIndex = 0;
volatile uint8_t currentSection = 0;
volatile uint8_t interpolatePosition = 0;
volatile uint8_t diff = 0;
volatile uint8_t value = 0;
volatile uint8_t nextValue = 0;
volatile uint16_t nextIndex = 1;

void InitMusic(PIT_CHANNEL channel) 
{
	InitPIT(channel, MusicNextSignal);
}

void ChooseTrack(uint8_t choice)
{
	MUSIC_CHOICE = choice;
}

void MusicNextSignal(void)
{
	uint8_t temp = 0;
	switch (MUSIC_CHOICE) 
	{
		case 1:
			if (interpolatePosition == 0) 
			{
				nextIndex = currentIndex + 1;
				if (nextIndex == _MUSIC_SECTION_LENGTH1) nextIndex = 0;
				value = MUSIC_TRACK1[currentSection][currentIndex];
				nextValue = MUSIC_TRACK1[currentSection][nextIndex];
				diff = (nextValue - value) / MUSIC_INTERPOLATION_RATIO;
			}
			temp = value + diff * interpolatePosition;
			AnalogWritePin(MUSIC_PIN, (uint16_t)((value + diff * interpolatePosition) << 4));
			interpolatePosition++;
			if (interpolatePosition == MUSIC_INTERPOLATION_RATIO) 
			{
				currentIndex++;
				interpolatePosition = 0;
			}
			if (currentIndex == _MUSIC_SECTION_LENGTH1)
			{
				currentIndex = 0;
				currentSection++;
				if (currentSection == _MUSIC_TRACK1_SECTIONS) currentSection = 0;
			}
			break;
		case 2:
			value = MUSIC_TRACK2[currentSection][currentIndex];
			temp = value;
			AnalogWritePin(MUSIC_PIN, (uint16_t)(value << 4));
			currentIndex++;
			if (currentIndex == _MUSIC_SECTION_LENGTH2)
			{
				currentIndex = 0;
				currentSection++;
				if (currentSection == _MUSIC_TRACK2_SECTIONS) currentSection = 0;
			}
			break;
		case 3:
			value = MUSIC_TRACK3[currentSection][currentIndex];
			temp = value;
			AnalogWritePin(MUSIC_PIN, (uint16_t)(value << 4));
			currentIndex++;
			if (currentIndex == _MUSIC_SECTION_LENGTH3)
			{
				currentIndex = 0;
				currentSection++;
				if (currentSection == _MUSIC_TRACK3_SECTIONS) currentSection = 0;
			}
			break;
	}
	DigitalWritePin(ExternalDAC_Pins[0], temp & 0x01 ? HIGH : LOW);
	DigitalWritePin(ExternalDAC_Pins[1], temp & 0x02 ? HIGH : LOW);
	DigitalWritePin(ExternalDAC_Pins[2], temp & 0x04 ? HIGH : LOW);
	DigitalWritePin(ExternalDAC_Pins[3], temp & 0x08 ? HIGH : LOW);
	DigitalWritePin(ExternalDAC_Pins[4], temp & 0x10 ? HIGH : LOW);
	DigitalWritePin(ExternalDAC_Pins[5], temp & 0x20 ? HIGH : LOW);
	DigitalWritePin(ExternalDAC_Pins[6], temp & 0x40 ? HIGH : LOW);
	DigitalWritePin(ExternalDAC_Pins[7], temp & 0x80 ? HIGH : LOW);
}

static const uint8_t MUSIC_TRACK1[_MUSIC_TRACK1_SECTIONS][_MUSIC_SECTION_LENGTH1] = 
{
{108,124,97,140,99,131,80,117,48,102,107,36,92,21,113,103,129,111,110,139,145,76,133,209,140,144,237,185,59,118,240,179,186,
209,173,254,228,137,156,131,93,121,97,46,126,149,203,157,125,107,112,165,91,17,66,117,104,133,116,78,114,209,143,75,3,57,69,
9,14,12,61,148,94,125,148,150,204,247,191,170,188,183,246,214,156,146,183,224,173,83,64,173,214,143,109,139,248,221,150,90,
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60,49,32,12,64,60,43,71,34,42,96,122,136,129,71,107,104,108,123,155,178,195,170,170,176,198,205,201,224,226,198,217,185}
};

static const uint8_t MUSIC_TRACK2[_MUSIC_TRACK2_SECTIONS][_MUSIC_SECTION_LENGTH2] = 
{
	{189,235,255,244,204,146,83,31,2,5,37,92,155,212,248,254,230,180,118,58,15,0,15,59,119,
		181,230,254,247,211,154,91,36,4,3,31,84,147,205,244,255,235,188,126,65,19,0,12,52,111,
		173,225,253,250,217,162,99,43,7,1,26,76,138}
};

static const uint8_t MUSIC_TRACK3[_MUSIC_TRACK3_SECTIONS][_MUSIC_SECTION_LENGTH3] = 
{
	{0xFF, 0}
};
